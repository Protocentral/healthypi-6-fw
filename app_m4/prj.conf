## CMakeLists.txt
```
#-------------------------------------------------------------------------------
# Zephyr M4 Application (Algorithm Processor)
#
# Copyright (c) 2021 Nordic Semiconductor ASA
# Copyright (c) 2025 ProtoCentral Electronics
# SPDX-License-Identifier: Apache-2.0

cmake_minimum_required(VERSION 3.13.1)
find_package(Zephyr REQUIRED HINTS $ENV{ZEPHYR_BASE})

# M4 is a calculations-only core (QRS/HR/HRV, SpO2) - C only.
# Arrhythmia ML classification lives on the HealthyLink Compute (NPU) module.
project(app LANGUAGES C)

# Application source files (C)
FILE(GLOB app_sources_c src/*.c)

# Add ring buffer implementation from parent directory
target_sources(app PRIVATE
    ${app_sources_c}
    ../src/ring_buffer.c
)

# Include directories
zephyr_include_directories(src)
```

## prj.conf
```kconfig
# M4 algorithm core: OpenAMP + CMSIS-DSP (calculations only).
# Arrhythmia ML classification runs on the HealthyLink Compute (NPU) module.

# CONFIG_IPM is not set
CONFIG_MBOX=y
CONFIG_MBOX_STM32_HSEM=y

# IPC Service Configuration - OpenAMP/RPMSG Backend
CONFIG_IPC_SERVICE=y
CONFIG_IPC_SERVICE_BACKEND_RPMSG=y
CONFIG_IPC_SERVICE_STATIC_VRINGS=y
CONFIG_IPC_SERVICE_RPMSG=y
CONFIG_OPENAMP=y
CONFIG_OPENAMP_RSC_TABLE=y

# Memory allocation
CONFIG_HEAP_MEM_POOL_SIZE=16384

CONFIG_SERIAL=y
CONFIG_CONSOLE=y
CONFIG_UART_CONSOLE=y
CONFIG_LOG_BACKEND_UART=y

CONFIG_LOG=y
CONFIG_LOG_DEFAULT_LEVEL=3
# Use immediate mode logging to bypass log thread (for debugging)
# This ensures logs appear in real-time, not buffered
CONFIG_LOG_MODE_IMMEDIATE=y

# CMSIS-DSP for HRV frequency domain analysis
CONFIG_CMSIS_DSP=y
CONFIG_CMSIS_DSP_TRANSFORM=y
CONFIG_CMSIS_DSP_STATISTICS=y
CONFIG_CMSIS_DSP_FASTMATH=y
CONFIG_CMSIS_DSP_BASICMATH=y
CONFIG_CMSIS_DSP_COMPLEXMATH=y

# FPU support (Cortex-M4 has single-precision FPU)
CONFIG_FPU=y
CONFIG_FPU_SHARING=y

# =============================================================================
# Runtime / stack configuration
# =============================================================================
# HRV FFT (CMSIS-DSP) + IPC use significant stack; keep a generous main stack.
CONFIG_MAIN_STACK_SIZE=8192
CONFIG_REQUIRES_FLOAT_PRINTF=y

# Fault handling - print info before reset on crashes
CONFIG_EXCEPTION_DEBUG=y
CONFIG_FAULT_DUMP=2

# Stack overflow detection
CONFIG_STACK_SENTINEL=y

# =============================================================================
# Boot debugging - help identify where freeze occurs
# =============================================================================
CONFIG_EARLY_CONSOLE=y
CONFIG_BOOT_BANNER=y
CONFIG_BOOT_DELAY=0
CONFIG_PRINTK=y

CONFIG_SPEED_OPTIMIZATIONS=y
CONFIG_FPU=y
```

## boards/healthypi6_v2_stm32h757xx_m4.overlay
```dts
/*
 * Device tree overlay for M4 core - External Memory Access
 *
 * NOTE: MPU is disabled (CONFIG_ARM_MPU=n) so memory-attr properties
 * are removed to avoid potential issues during early boot.
 *
 * SDRAM1 is initialized by M7 before M4 accesses it
 * (handled by M4's 7-second boot delay in main.c).
 *
 * Memory regions defined in base DTS:
 * - SDRAM1 @ 0xC0000000 (32MB) - W9825G6KH chip, shared M7/M4
 * - QSPI @ 0x90000000 (128MB) - not defined here, accessed via raw pointers
 *
 * NOTE: There is NO SDRAM2. FMC Bank 1 (0xD0000000) is not connected.
 */

/* Currently empty - using base DTS memory region definitions only */
```

## src/main.c
```c
/*
 * Copyright (c) 2024-2026 Protocentral Electronics
 *
 * SPDX-License-Identifier: MIT
 */

#include <zephyr/kernel.h>
#include <zephyr/device.h>
#include <zephyr/logging/log.h>

#include "ipc_module.h"
#include "algorithm_module.h"
#include "spo2_module.h"
#include "../../app_m7/src/hpi_common_types.h"

#define LOG_LEVEL CONFIG_LOG_DEFAULT_LEVEL
LOG_MODULE_REGISTER(healthypi6_m4, LOG_LEVEL_INF);

/* Workqueue pattern (load-bearing): IPC callbacks must only enqueue and
 * return in <100 µs — any processing in the callback blocks the IPC thread
 * and overflows the RPMSG buffers. Work handlers drain the message queues
 * asynchronously; the queues provide the elastic buffering.
 */

/* Message queues buffer data between fast IPC callbacks and slower processing */
K_MSGQ_DEFINE(q_ppg_batches, 
              sizeof(struct hpi_ipc_ppg_raw_batch), 
              32,  /* 32 entries = ~256ms buffering at 125 batches/sec */
              4);  /* Alignment */

K_MSGQ_DEFINE(q_ecg_batches, 
              sizeof(struct hpi_ipc_ecg_raw_batch), 
              32,  /* 32 entries = ~1s buffering at 31.25 batches/sec */
              4);

K_MSGQ_DEFINE(q_eeg_batches, 
              sizeof(struct hpi_ipc_eeg_raw_batch), 
              32,  /* 32 entries = ~1s buffering at 31.25 batches/sec */
              4);

/* ============================================================================
 * Statistics Tracking
 * ============================================================================ */

/* PPG Statistics */
static uint32_t ppg_batches_received = 0;
static uint32_t ppg_samples_received = 0;
static uint32_t ppg_last_sample_num = 0;
static uint32_t ppg_sequence_errors = 0;
static uint32_t ppg_last_timestamp = 0;
static atomic_t ppg_queue_drops = ATOMIC_INIT(0);

/* ECG Statistics */
static uint32_t ecg_batches_received = 0;
static uint32_t ecg_samples_received = 0;
static uint32_t ecg_last_sample_num = 0;
static uint32_t ecg_sequence_errors = 0;
static uint32_t ecg_last_timestamp = 0;
static atomic_t ecg_queue_drops = ATOMIC_INIT(0);

/* EEG Statistics */
static uint32_t eeg_batches_received = 0;
static uint32_t eeg_samples_received = 0;
static uint32_t eeg_last_sample_num = 0;
static uint32_t eeg_sequence_errors = 0;
static uint32_t eeg_last_timestamp = 0;
static atomic_t eeg_queue_drops = ATOMIC_INIT(0);

/* ============================================================================
 * Work Handlers - Forward Declarations
 * ============================================================================ */

static void ppg_work_handler(struct k_work *work);
static void ecg_work_handler(struct k_work *work);
static void eeg_work_handler(struct k_work *work);

/* Work items (triggered by IPC callbacks) */
K_WORK_DEFINE(ppg_work, ppg_work_handler);
K_WORK_DEFINE(ecg_work, ecg_work_handler);
K_WORK_DEFINE(eeg_work, eeg_work_handler);

/* IPC callbacks - fast enqueue only. They run in IPC thread context
 * (priority 5) and MUST return in <100 µs: validate size, k_msgq_put with
 * K_NO_WAIT, submit the work item, return. All processing happens in the
 * work handlers. */

/**
 * @brief PPG IPC callback - enqueue for ppg_work_handler()
 *
 * @param type Message type (HPI_IPC_MSG_TYPE_PPG_RAW = 0x10)
 * @param data Pointer to hpi_ipc_ppg_raw_batch structure
 * @param len Length in bytes (should be 388 bytes)
 * @param user_data User data (unused)
 */
static void ppg_raw_callback(enum hpi_ipc_msg_type type, 
                            const void *data, 
                            size_t len, 
                            void *user_data)
{
	/* Quick validation - reject obviously invalid data */
	if (len < sizeof(struct hpi_ipc_ppg_raw_batch)) {
		return;  /* Silently drop - avoid logging in hot path */
	}
	
	/* Fast path: enqueue data for processing */
	if (k_msgq_put(&q_ppg_batches, data, K_NO_WAIT) == 0) {
		/* Successfully queued - trigger work handler */
		k_work_submit(&ppg_work);
	} else {
		/* Queue full - drop message (backpressure) */
		atomic_inc(&ppg_queue_drops);
	}
}

/**
 * @brief ECG IPC callback - enqueue for ecg_work_handler()
 *
 * @param msg_type Message type (HPI_IPC_MSG_TYPE_ECG_RAW = 0x20)
 * @param data Pointer to hpi_ipc_ecg_raw_batch structure
 * @param len Length in bytes (should be 452 bytes)
 * @param user_data User data (unused)
 */
static void ecg_raw_callback(enum hpi_ipc_msg_type msg_type, 
                             const void *data, size_t len, void *user_data)
{
	/* Quick validation */
	if (len < sizeof(struct hpi_ipc_ecg_raw_batch)) {
		return;
	}
	
	/* Fast path: enqueue */
	if (k_msgq_put(&q_ecg_batches, data, K_NO_WAIT) == 0) {
		k_work_submit(&ecg_work);
	} else {
		atomic_inc(&ecg_queue_drops);
	}
}

/**
 * @brief EEG IPC callback - enqueue for eeg_work_handler()
 *
 * @param msg_type Message type (HPI_IPC_MSG_TYPE_EEG_RAW = 0x30)
 * @param data Pointer to hpi_ipc_eeg_raw_batch structure
 * @param len Length in bytes (should be 324 bytes)
 * @param user_data User data (unused)
 */
static void eeg_raw_callback(enum hpi_ipc_msg_type msg_type, 
                             const void *data, size_t len, void *user_data)
{
	/* Quick validation */
	if (len < sizeof(struct hpi_ipc_eeg_raw_batch)) {
		return;
	}
	
	/* Fast path: enqueue */
	if (k_msgq_put(&q_eeg_batches, data, K_NO_WAIT) == 0) {
		k_work_submit(&eeg_work);
	} else {
		atomic_inc(&eeg_queue_drops);
	}
}

/* Work handlers - run in system work queue context at lower priority than
 * the IPC thread. They drain the message queues and do the real processing
 * (validation, stats, sequence checks, algorithms) and may take multiple
 * milliseconds without blocking IPC reception. */

/**
 * @brief PPG work handler - drain and process queued PPG batches
 *
 * @param work Work item (ppg_work)
 */
static void ppg_work_handler(struct k_work *work)
{
	struct hpi_ipc_ppg_raw_batch batch;
	
	/* Process all queued batches (drain queue) */
	while (k_msgq_get(&q_ppg_batches, &batch, K_NO_WAIT) == 0) {
		
		/* Validation (moved from callback) */
		if (batch.sample_count == 0 || batch.sample_count > HPI_PPG_BATCH_SIZE) {
			LOG_WRN("Invalid PPG sample_count: %u", batch.sample_count);
			continue;
		}
		
		/* Update statistics (moved from callback) */
		ppg_batches_received++;
		ppg_samples_received += batch.sample_count;
		
		/* Check for sequence errors (moved from callback) */
		if (ppg_batches_received > 1) {
			uint32_t first_sample_num = batch.samples[0].sample_number;
			uint32_t expected_num = (ppg_last_sample_num + 1) % 65536;
			
			if (first_sample_num != expected_num) {
				ppg_sequence_errors++;
				LOG_WRN("PPG sequence error: expected %u, got %u (gap: %d)",
				        expected_num, first_sample_num,
				        (int)(first_sample_num - expected_num));
			}
		}
		
		/* Update last sample tracking */
		ppg_last_sample_num = batch.samples[batch.sample_count - 1].sample_number;
		ppg_last_timestamp = batch.samples[batch.sample_count - 1].timestamp_ms;
		
		/* Periodic debug log to verify M4 receive integrity */
		if ((ppg_batches_received % 100) == 0) {
			LOG_DBG("[M4-RX] Batch %u: IR[0]=%d, Red[0]=%d",
			        ppg_batches_received,
			        batch.samples[0].ir_raw,
			        batch.samples[0].red_raw);
		}

		/* The M4 deliberately sends no per-batch acknowledgment: the
		 * bidirectional traffic saturates the IPC buffers even from work
		 * context. The same applies to the ECG and EEG handlers below. */

		/* TODO: Algorithm processing
		 * spo2_algorithm_process_batch(&algo_state, &batch);
		 */
	}
}

/**
 * @brief ECG work handler - drain and process queued ECG batches
 *
 * @param work Work item (ecg_work)
 */
static void ecg_work_handler(struct k_work *work)
{
	struct hpi_ipc_ecg_raw_batch batch;
	
	/* Process all queued batches */
	while (k_msgq_get(&q_ecg_batches, &batch, K_NO_WAIT) == 0) {
		
		/* Validation */
		if (batch.sample_count == 0 || batch.sample_count > HPI_ECG_BATCH_SIZE) {
			LOG_WRN("Invalid ECG sample_count: %u", batch.sample_count);
			continue;
		}
		
		/* Update statistics */
		ecg_batches_received++;
		ecg_samples_received += batch.sample_count;
		
		/* Check for sequence gaps */
		if (ecg_batches_received > 1) {
			uint32_t expected_num = ecg_last_sample_num + 1;
			uint32_t actual_num = batch.samples[0].sample_number;
			if (actual_num != expected_num) {
				ecg_sequence_errors++;
				LOG_WRN("ECG sequence gap: expected %u, got %u (gap=%d)",
				        expected_num, actual_num, (int32_t)(actual_num - expected_num));
			}
		}
		
		/* Update last sample tracking */
		ecg_last_sample_num = batch.samples[batch.sample_count - 1].sample_number;
		ecg_last_timestamp = batch.samples[batch.sample_count - 1].timestamp_ms;

		/* TODO: QRS detection algorithm
		 * pan_tompkins_process_batch(&qrs_state, &batch);
		 */
	}
}

/**
 * @brief EEG work handler - drain and process queued EEG batches
 *
 * @param work Work item (eeg_work)
 */
static void eeg_work_handler(struct k_work *work)
{
	struct hpi_ipc_eeg_raw_batch batch;
	
	/* Process all queued batches */
	while (k_msgq_get(&q_eeg_batches, &batch, K_NO_WAIT) == 0) {
		
		/* Validation */
		if (batch.sample_count == 0 || batch.sample_count > HPI_EEG_BATCH_SIZE) {
			LOG_WRN("Invalid EEG sample_count: %u", batch.sample_count);
			continue;
		}
		
		/* Update statistics */
		eeg_batches_received++;
		eeg_samples_received += batch.sample_count;
		
		/* Check for sequence gaps */
		if (eeg_batches_received > 1) {
			uint32_t expected_num = eeg_last_sample_num + 1;
			uint32_t actual_num = batch.samples[0].sample_number;
			if (actual_num != expected_num) {
				eeg_sequence_errors++;
				LOG_WRN("EEG sequence gap: expected %u, got %u (gap=%d)",
				        expected_num, actual_num, (int32_t)(actual_num - expected_num));
			}
		}
		
		/* Update last sample tracking */
		eeg_last_sample_num = batch.samples[batch.sample_count - 1].sample_number;
		eeg_last_timestamp = batch.samples[batch.sample_count - 1].timestamp_ms;

		/* TODO: EEG frequency band analysis
		 * eeg_fft_process_batch(&eeg_state, &batch);
		 */
	}
}

/* Statistics printing */

/**
 * @brief Print PPG reception statistics
 */
static void print_ppg_stats(void)
{
	LOG_INF("========================================");
	LOG_INF("PPG Reception Statistics (M4)");
	LOG_INF("========================================");
	LOG_INF("  Batches received:    %u", ppg_batches_received);
	LOG_INF("  Samples received:    %u", ppg_samples_received);
	LOG_INF("  Sequence errors:     %u", ppg_sequence_errors);
	LOG_INF("  Last sample #:       %u", ppg_last_sample_num);
	LOG_INF("  Last timestamp:      %u ms", ppg_last_timestamp);
	
	if (ppg_batches_received > 0) {
		uint32_t uptime_sec = k_uptime_get_32() / 1000;
		if (uptime_sec > 0) {
			uint32_t batch_rate = ppg_batches_received / uptime_sec;
			uint32_t sample_rate = ppg_samples_received / uptime_sec;
			LOG_INF("  Batch rate:          %u batches/sec (target: 31)", batch_rate);
			LOG_INF("  Sample rate:         %u samples/sec (target: 500)", sample_rate);
			
			if (ppg_sequence_errors > 0) {
				uint32_t error_pct = (ppg_sequence_errors * 100) / ppg_batches_received;
				LOG_INF("  Error rate:          %u%% (%u errors)", 
				        error_pct, ppg_sequence_errors);
			}
		}
	}
	LOG_INF("========================================");
}

/**
 * @brief Print ECG reception statistics
 */
static void print_ecg_stats(void)
{
	LOG_INF("========================================");
	LOG_INF("ECG Reception Statistics (M4)");
	LOG_INF("========================================");
	LOG_INF("  Batches received:    %u", ecg_batches_received);
	LOG_INF("  Samples received:    %u", ecg_samples_received);
	LOG_INF("  Sequence errors:     %u", ecg_sequence_errors);
	LOG_INF("  Last sample #:       %u", ecg_last_sample_num);
	LOG_INF("  Last timestamp:      %u ms", ecg_last_timestamp);
	
	if (ecg_batches_received > 0) {
		uint32_t uptime_sec = k_uptime_get_32() / 1000;
		if (uptime_sec > 0) {
			uint32_t batch_rate = ecg_batches_received / uptime_sec;
			uint32_t sample_rate = ecg_samples_received / uptime_sec;
			LOG_INF("  Batch rate:          %u batches/sec (target: 31)", batch_rate);
			LOG_INF("  Sample rate:         %u samples/sec (target: 500)", sample_rate);
			
			if (ecg_sequence_errors > 0) {
				uint32_t error_pct = (ecg_sequence_errors * 100) / ecg_batches_received;
				LOG_INF("  Error rate:          %u%% (%u errors)", 
				        error_pct, ecg_sequence_errors);
			}
		}
	}
	LOG_INF("========================================");
}

/**
 * @brief Print EEG reception statistics
 */
static void print_eeg_stats(void)
{
	LOG_INF("========================================");
	LOG_INF("EEG Reception Statistics (M4)");
	LOG_INF("========================================");
	LOG_INF("  Batches received:    %u", eeg_batches_received);
	LOG_INF("  Samples received:    %u", eeg_samples_received);
	LOG_INF("  Sequence errors:     %u", eeg_sequence_errors);
	LOG_INF("  Last sample #:       %u", eeg_last_sample_num);
	LOG_INF("  Last timestamp:      %u ms", eeg_last_timestamp);
	
	if (eeg_batches_received > 0) {
		uint32_t uptime_sec = k_uptime_get_32() / 1000;
		if (uptime_sec > 0) {
			uint32_t batch_rate = eeg_batches_received / uptime_sec;
			uint32_t sample_rate = eeg_samples_received / uptime_sec;
			LOG_INF("  Batch rate:          %u batches/sec (target: 31)", batch_rate);
			LOG_INF("  Sample rate:         %u samples/sec (target: 500)", sample_rate);
			
			if (eeg_sequence_errors > 0) {
				uint32_t error_pct = (eeg_sequence_errors * 100) / eeg_batches_received;
				LOG_INF("  Error rate:          %u%% (%u errors)", 
				        error_pct, eeg_sequence_errors);
			}
		}
	}
	LOG_INF("========================================");
}

/* ============================================================================
 * Main Function - Initialization and Statistics Loop
 * ============================================================================ */

int main(void)
{
	LOG_INF("========================================");
	LOG_INF("  HealthyPi 6 - M4 Core Starting");
	LOG_INF("  OpenAMP/RPMSG IPC Backend");
	LOG_INF("========================================");
	LOG_INF("Configuration:");
	LOG_INF("  IPC Backend:    OpenAMP Static VRINGs");
	LOG_INF("  M4 Heap Size:   %d bytes", CONFIG_HEAP_MEM_POOL_SIZE);
	LOG_INF("  PPG Queue Size: 32 entries (~256ms buffering)");
	LOG_INF("  ECG Queue Size: 32 entries (~1s buffering)");
	LOG_INF("  EEG Queue Size: 32 entries (~1s buffering)");
	LOG_INF("========================================");
	
	/* Initialize IPC for M7 communication: opens the OpenAMP instance and
	 * registers the RPMSG endpoint that binds to the M7 (M4 = REMOTE). */
	int ret = hpi_ipc_init();
	if (ret != 0) {
		LOG_ERR("M4: Failed to initialize IPC: %d", ret);
	} else {
		LOG_INF("M4: IPC initialized");
	}
	
	/* Register fast callbacks (workqueue pattern). PPG is registered by the
	 * SpO2 module and ECG by algorithm_module; only EEG is registered here,
	 * because it has no algorithm module yet. */
	ret = hpi_ipc_register_callback(HPI_IPC_MSG_TYPE_EEG_RAW,
	                                 eeg_raw_callback,
	                                 NULL);
	if (ret < 0) {
		LOG_ERR("Failed to register EEG callback: %d", ret);
	} else {
		LOG_INF("EEG callback registered (fast enqueue, Type 0x30)");
	}
	
	LOG_INF("========================================");
	LOG_INF("M4 initialization complete");
	LOG_INF("Ready to receive PPG, ECG & EEG batches");
	LOG_INF("NOTE: PPG → SpO2 module, ECG → Algorithm module, EEG → main.c");
	LOG_INF("========================================");
	
	/* Initialize Algorithm Module (QRS detection) */
	LOG_INF("Initializing algorithm module...");
	ret = algorithm_module_init();
	if (ret < 0) {
		LOG_ERR("Failed to initialize algorithm module: %d", ret);
	} else {
		LOG_INF("Algorithm module initialized successfully");
		
		/* Register algorithm IPC callbacks */
		ret = algorithm_register_ipc_callbacks();
		if (ret < 0) {
			LOG_ERR("Failed to register algorithm callbacks: %d", ret);
		} else {
			LOG_INF("Algorithm callbacks registered");
			
			/* Start algorithm processing */
			ret = algorithm_module_start();
			if (ret < 0) {
				LOG_ERR("Failed to start algorithm module: %d", ret);
			} else {
				LOG_INF("Algorithm module started - QRS detection active");
			}
		}
	}
	LOG_INF("========================================");

	/* Initialize SpO2 Module (SpO2 + PPG-HR). The M7 feeds PPG_RAW decimated
	 * to the 125 Hz this module expects (see app_m7 platform/ipc.c forward_ppg).
	 */
#if 1
	LOG_INF("Initializing SpO2 module...");
	ret = spo2_module_init();
	if (ret < 0) {
		LOG_ERR("Failed to initialize SpO2 module: %d", ret);
	} else {
		LOG_INF("SpO2 module initialized successfully");

		/* Start SpO2 processing */
		ret = spo2_module_start();
		if (ret < 0) {
			LOG_ERR("Failed to start SpO2 module: %d", ret);
		} else {
			LOG_INF("SpO2 module started - SpO2 + PPG-HR calculation active");
		}
	}
#else
	LOG_INF("SpO2 module DISABLED - re-enable when validated");
#endif
	LOG_INF("========================================");

	/* Arrhythmia / beat classification is NOT performed on the M4 core.
	 * The M4 does signal calculations only (QRS/HR/HRV, SpO2). ML arrhythmia
	 * classification runs on the HealthyLink Compute (STM32N657 NPU) module
	 * when installed - its firmware is the separate
	 * Protocentral/healthylink-compute-fw repository. */
	LOG_INF("Arrhythmia classification: handled by HealthyLink Compute module");
	LOG_INF("========================================");

	/* Main loop - minimal logging, only show warnings/errors */
	uint32_t loop_count = 0;

	for (;;) {
		k_sleep(K_SECONDS(10));
		loop_count++;

		/* Get queue usage (32 - free = used) */
		uint32_t ppg_used = 32 - k_msgq_num_free_get(&q_ppg_batches);
		uint32_t ecg_used = 32 - k_msgq_num_free_get(&q_ecg_batches);
		uint32_t eeg_used = 32 - k_msgq_num_free_get(&q_eeg_batches);

		/* Get drop counts */
		uint32_t ppg_drops = atomic_get(&ppg_queue_drops);
		uint32_t ecg_drops = atomic_get(&ecg_queue_drops);
		uint32_t eeg_drops = atomic_get(&eeg_queue_drops);

		/* Get algorithm statistics */
		struct algorithm_stats algo_stats;
		algorithm_get_stats(&algo_stats);

		/* Log warnings and errors only. */
		if (ppg_used > 16 || ecg_used > 16 || eeg_used > 16) {
			LOG_WRN("Queue usage >50%%: PPG=%u, ECG=%u, EEG=%u",
			        ppg_used, ecg_used, eeg_used);
		}
		if (ppg_drops > 0 || ecg_drops > 0 || eeg_drops > 0) {
			LOG_ERR("Message drops: PPG=%u, ECG=%u, EEG=%u",
			        ppg_drops, ecg_drops, eeg_drops);
		}
		if (algo_stats.algorithm_overruns > 0) {
			LOG_WRN("Algorithm queue overruns: %u", algo_stats.algorithm_overruns);
		}
	}

	return 0;
}
```

## src/algorithm_module.h
```c
/*
 * Copyright (c) 2024 ProtoCentral Electronics
 * SPDX-License-Identifier: MIT
 * 
 * Algorithm Module - M4 Core Signal Processing
 * QRS detection and heart-rate calculation
 */

#ifndef ALGORITHM_MODULE_H
#define ALGORITHM_MODULE_H

#include <zephyr/kernel.h>
#include <stdint.h>

#ifdef __cplusplus
extern "C" {
#endif

/* Algorithm Results Structures */

/**
 * @brief ECG algorithm results (QRS detection, heart rate)
 */
struct ecg_algorithm_results {
    uint32_t timestamp;           /* Timestamp in milliseconds */
    uint16_t heart_rate;          /* Heart rate in BPM (30-200) */
    uint16_t rr_interval_ms;      /* RR interval in milliseconds */
    uint8_t qrs_detected;         /* 1 if QRS detected in this update, 0 otherwise */
    uint8_t signal_quality;       /* Signal quality 0-100% */
    uint8_t confidence;           /* HR confidence 0-100% */
    uint8_t reserved;             /* Padding for alignment */
} __packed;

/**
 * @brief PPG algorithm results (SpO2, perfusion index)
 */
struct ppg_algorithm_results {
    uint32_t timestamp;
    uint16_t spo2;                /* SpO2 percentage (0-100) */
    uint16_t perfusion_index;     /* PI in 0.1% units (0-200 = 0-20%) */
    uint16_t pulse_rate;          /* Pulse rate from PPG (30-200 BPM) */
    uint8_t confidence;           /* 0-100% */
    uint8_t reserved;
} __packed;

/**
 * @brief Combined vital signs update
 */
struct vital_signs_update {
    uint32_t timestamp;
    uint16_t heart_rate;          /* From ECG */
    uint16_t spo2;                /* From PPG */
    uint16_t respiration_rate;    /* Breaths per minute */
    uint8_t signal_quality_ecg;
    uint8_t signal_quality_ppg;
} __packed;

/* Algorithm Configuration */

/**
 * @brief ECG algorithm configuration parameters
 */
struct ecg_algorithm_config {
    uint16_t sample_rate;         /* Samples per second (500 Hz default) */
    uint16_t filter_lowcut;       /* High-pass cutoff in 0.1 Hz units (5 Hz default) */
    uint16_t filter_highcut;      /* Low-pass cutoff in 0.1 Hz units (15 Hz default) */
    uint16_t detection_threshold; /* QRS detection threshold (adaptive if 0) */
    uint8_t averaging_window;     /* Number of beats to average (10 default) */
    uint8_t enable_noise_reject;  /* Enable motion artifact rejection */
};

/* Algorithm Statistics */

/**
 * @brief Algorithm module statistics
 */
struct algorithm_stats {
    uint32_t ecg_batches_processed;
    uint32_t ppg_batches_processed;
    uint32_t qrs_detections_total;
    uint32_t hr_updates_sent;
    uint32_t algorithm_overruns;
    uint32_t queue_max_usage;
    uint32_t processing_time_us_max;
    uint32_t processing_time_us_avg;
};

/* Public API Functions */

/**
 * @brief Initialize algorithm module
 * 
 * Sets up threads, message queues, and algorithm state.
 * Must be called before any other algorithm functions.
 * 
 * @return 0 on success, negative errno on error
 */
int algorithm_module_init(void);

/**
 * @brief Start algorithm processing
 * 
 * Starts algorithm threads after IPC is ready.
 * 
 * @return 0 on success, negative errno on error
 */
int algorithm_module_start(void);

/**
 * @brief Get algorithm statistics
 * 
 * @param stats Pointer to statistics structure to fill
 * @return 0 on success, negative errno on error
 */
int algorithm_get_stats(struct algorithm_stats *stats);

/**
 * @brief Configure ECG algorithm parameters
 * 
 * @param config Pointer to configuration structure
 * @return 0 on success, negative errno on error
 */
int algorithm_configure_ecg(const struct ecg_algorithm_config *config);

/**
 * @brief Reset algorithm state
 * 
 * Clears all buffers and resets detection thresholds.
 * Useful for handling lead-off or signal quality issues.
 */
void algorithm_reset(void);

/* Internal Processing Functions (exposed for testing) */

/**
 * @brief Process single ECG batch (16 samples)
 * 
 * Performs QRS detection and heart rate calculation.
 * Called by ECG algorithm thread.
 * 
 * @param batch Pointer to ECG batch structure
 * @param results Pointer to results structure to fill
 * @return 0 on success, negative errno on error
 */
int ecg_process_batch(const void *batch, struct ecg_algorithm_results *results);

/**
 * @brief Detect QRS complex in filtered ECG signal
 * 
 * Implements Pan-Tompkins algorithm for QRS detection.
 * 
 * @param samples Array of filtered ECG samples
 * @param count Number of samples
 * @param detected_index Output: index of detected QRS peak (if found)
 * @return 1 if QRS detected, 0 if not, negative errno on error
 */
int qrs_detect(const int32_t *samples, size_t count, size_t *detected_index);

/**
 * @brief Calculate heart rate from the newest RR intervals
 *
 * Median of the newest min(count, 8) intervals of a circular RR buffer.
 *
 * @param rr_intervals Circular RR buffer (milliseconds), RR_HISTORY_SIZE long
 * @param count Number of valid intervals in it
 * @param next_index Slot the next interval will be written to (the newest
 *                   interval is the one before it)
 * @return Heart rate in BPM clamped to 30-200, or 0 if no data
 */
uint16_t calculate_heart_rate(const uint16_t *rr_intervals, size_t count,
                              size_t next_index);

/* NOTE: The M4 performs signal calculations only (QRS/HR/HRV/SpO2). ML
 * arrhythmia classification runs on the HealthyLink Compute (STM32N657 NPU)
 * module when installed - its firmware is the separate
 * Protocentral/healthylink-compute-fw repository. */

/**
 * @brief Enable or disable HRV calculation (disabled by default)
 *
 * Time domain: SDNN, RMSSD, pNN50 (updated every 5 s).
 * Frequency domain: LF, HF, LF/HF ratio (updated every 60 s).
 *
 * @param enable true to enable HRV, false to disable
 */
void algorithm_set_hrv_enabled(bool enable);

/**
 * @brief Check if HRV calculation is enabled
 *
 * @return true if HRV is enabled, false otherwise
 */
bool algorithm_is_hrv_enabled(void);

/**
 * @brief Register IPC callbacks for algorithm module
 *
 * @return 0 on success, negative errno on error
 */
int algorithm_register_ipc_callbacks(void);

#ifdef __cplusplus
}
#endif

#endif /* ALGORITHM_MODULE_H */
```

## src/ipc_module.c
```c
/*
 * Copyright (c) 2024 Protocentral
 *
 * SPDX-License-Identifier: MIT
 */

#include <app_version.h>

#include "ipc_module.h"
#include <zephyr/kernel.h>
#include <zephyr/device.h>
#include <zephyr/ipc/ipc_service.h>
#include <zephyr/logging/log.h>
#include <string.h>

LOG_MODULE_REGISTER(ipc_module_m4, LOG_LEVEL_DBG);

/* IPC endpoint and configuration */
static struct ipc_ept hpi_ipc_ept;
static const struct device *ipc_instance;
static bool ipc_ready = false;

/* Semaphore for IPC bound state */
K_SEM_DEFINE(ipc_bound_sem, 0, 1);



/* Message callbacks */
static struct {
	hpi_ipc_msg_callback_t callback;
	void *user_data;
} msg_callbacks[HPI_IPC_MSG_TYPE_MAX];

/* Statistics */
static struct hpi_ipc_stats ipc_stats = {0};

/* IPC endpoint callbacks */
static void hpi_ipc_ept_bound(void *priv)
{
	LOG_INF("IPC endpoint bound - M4 REMOTE ready");
	ipc_ready = true;
	k_sem_give(&ipc_bound_sem);
}

static void hpi_ipc_ept_unbound(void *priv)
{
	LOG_WRN("IPC endpoint unbound");
	ipc_ready = false;
}

static void hpi_ipc_ept_recv(const void *data, size_t len, void *priv)
{
	const struct hpi_ipc_msg *msg = (const struct hpi_ipc_msg *)data;
	
	if (len < sizeof(struct hpi_ipc_msg)) {
		LOG_ERR("IPC message too small: %d", len);
		ipc_stats.receive_errors++;
		return;
	}

	if (msg->type >= HPI_IPC_MSG_TYPE_MAX) {
		LOG_ERR("IPC invalid message type: %d", msg->type);
		ipc_stats.receive_errors++;
		return;
	}

	if (msg->length != (len - sizeof(struct hpi_ipc_msg))) {
		LOG_ERR("IPC message length mismatch: expected=%d, actual=%d", 
			msg->length, len - sizeof(struct hpi_ipc_msg));
		ipc_stats.receive_errors++;
		return;
	}

	ipc_stats.messages_received++;

	/* Call registered callback if available */
	if (msg_callbacks[msg->type].callback) {
		msg_callbacks[msg->type].callback(msg->type, msg->data, msg->length,
						  msg_callbacks[msg->type].user_data);
	}
}

static void hpi_ipc_ept_error(const char *message, void *priv)
{
	LOG_ERR("IPC endpoint error: %s", message);
	ipc_stats.send_errors++;
}

/* IPC endpoint configuration */
static struct ipc_ept_cfg hpi_ipc_ept_cfg = {
	.name = "hpi_ipc",
	.cb = {
		.bound    = hpi_ipc_ept_bound,
		.unbound  = hpi_ipc_ept_unbound,
		.received = hpi_ipc_ept_recv,
		.error    = hpi_ipc_ept_error,
	},
};

int hpi_ipc_init(void)
{
	int ret;

	LOG_INF("Initializing IPC service - M4 REMOTE");
	
	/* M7 takes ~6-8 seconds to boot (display + hardware init).
	 * Wait with generous timeout for M7 to complete IPC initialization. */
	LOG_INF("M4: Waiting for M7 to initialize IPC (M7 boots slower due to display)...");
	
	/* Give M7 time to open IPC instance and register endpoint */
	LOG_INF("M4: Waiting 7 seconds for M7 to reach IPC init...");
	k_sleep(K_SECONDS(7));
	LOG_INF("M4: Proceeding with IPC initialization...");
	
	/* Get IPC instance from device tree */
	ipc_instance = DEVICE_DT_GET(DT_NODELABEL(ipc0));
	if (!device_is_ready(ipc_instance)) {
		LOG_ERR("IPC instance not ready");
		return -ENODEV;
	}
	LOG_INF("M4: IPC instance ready");

	/* Open IPC instance */
	ret = ipc_service_open_instance(ipc_instance);
	if (ret < 0 && ret != -EALREADY) {
		LOG_ERR("Failed to open IPC instance: %d", ret);
		return ret;
	}
	LOG_INF("M4: IPC instance opened (ret=%d)", ret);

	/* Register endpoint - REMOTE registers and waits for HOST to bind */
	LOG_INF("M4: Registering endpoint as REMOTE (will wait for HOST)...");
	ret = ipc_service_register_endpoint(ipc_instance, &hpi_ipc_ept, &hpi_ipc_ept_cfg);
	if (ret < 0) {
		LOG_ERR("Failed to register IPC endpoint: %d", ret);
		return ret;
	}
	LOG_INF("M4: Endpoint registered, waiting for HOST to bind...");

	/* Wait for endpoint to be bound 
	 * M7 takes ~6-8 seconds to boot (display + hardware init), so give it 15s */
	LOG_INF("M4: Waiting up to 15s for M7 HOST to bind...");
	ret = k_sem_take(&ipc_bound_sem, K_MSEC(15000));
	if (ret != 0) {
		LOG_ERR("IPC endpoint binding timeout (15s)");
		return -ETIMEDOUT;
	}

	LOG_INF("IPC service initialized successfully - M4 REMOTE");

	/* Report our firmware version to the M7 first thing after binding. The M4
	 * image is host-updatable, and the M4 console (USART2) is not broken out
	 * on v5, so this IPC message is the only way the running version is
	 * observable (surfaced as m4fw in device_info / fw_versions). Non-fatal:
	 * a send failure must not fail the bind. */
	{
		struct hpi_ipc_version ver = {0};
		strncpy(ver.version, APP_VERSION_STRING, sizeof(ver.version) - 1);
		int vret = hpi_ipc_send(HPI_IPC_MSG_TYPE_VERSION, &ver, sizeof(ver));
		if (vret < 0) {
			LOG_WRN("M4: version report failed (%d) - continuing", vret);
		} else {
			LOG_INF("M4: reported version %s", ver.version);
		}
	}

	return 0;
}

int hpi_ipc_send(enum hpi_ipc_msg_type msg_type, const void *data, size_t len)
{
	struct hpi_ipc_msg *msg;
	size_t total_len;
	int ret;

	if (!ipc_ready) {
		LOG_ERR("IPC not ready");
		return -ENOTCONN;
	}

	if (msg_type >= HPI_IPC_MSG_TYPE_MAX) {
		LOG_ERR("Invalid message type: %d", msg_type);
		return -EINVAL;
	}

	if (len > HPI_IPC_MAX_DATA_SIZE) {
		LOG_ERR("Message data too large: %d", len);
		return -EMSGSIZE;
	}

	total_len = sizeof(struct hpi_ipc_msg) + len;
	msg = k_malloc(total_len);
	if (!msg) {
		LOG_ERR("Failed to allocate message buffer");
		ipc_stats.send_errors++;
		return -ENOMEM;
	}

	/* Prepare message */
	msg->type = msg_type;
	msg->reserved = 0;
	msg->length = len;
	if (data && len > 0) {
		memcpy(msg->data, data, len);
	}

	/* Send message */
	ret = ipc_service_send(&hpi_ipc_ept, msg, total_len);
	if (ret < 0) {
		LOG_ERR("Failed to send IPC message: %d", ret);
		ipc_stats.send_errors++;
	} else {
		ipc_stats.messages_sent++;
		ret = 0;  /* Success - normalize return value */
	}

	k_free(msg);
	return ret;
}

bool hpi_ipc_is_ready(void)
{
	return ipc_ready;
}

int hpi_ipc_register_callback(enum hpi_ipc_msg_type msg_type,
			      hpi_ipc_msg_callback_t callback,
			      void *user_data)
{
	if (msg_type >= HPI_IPC_MSG_TYPE_MAX) {
		return -EINVAL;
	}

	msg_callbacks[msg_type].callback = callback;
	msg_callbacks[msg_type].user_data = user_data;

	LOG_DBG("Registered callback for message type %d", msg_type);
	return 0;
}

void hpi_ipc_get_stats(struct hpi_ipc_stats *stats)
{
	if (stats) {
		*stats = ipc_stats;
	}
}


/* IPC message callback functions */
static void ipc_test_msg_callback(enum hpi_ipc_msg_type msg_type,
				  const void *data, size_t len, void *user_data)
{
	/* Logged only: replying here would add bidirectional traffic that can
	 * saturate the IPC buffers. */
	LOG_DBG("M4: Received IPC test message from M7, len=%d", len);
}

static void ipc_cmd_msg_callback(enum hpi_ipc_msg_type msg_type,
				 const void *data, size_t len, void *user_data)
{
	/* Logged only: see ipc_test_msg_callback(). */
	LOG_DBG("M4: Received IPC command message from M7, len=%d", len);
}

/* Called directly from main(); there is deliberately no IPC thread here. An
 * auto-started one caused duplicate initialization and timing races. */
int hpi_ipc_m4_init(void)
{
	int ret;

	/* Initialize IPC service - M4 (remote) should initialize before M7 (host) */
	LOG_INF("M4: Initializing IPC service...");
	ret = hpi_ipc_init();
	if (ret < 0) {
		LOG_ERR("M4: Failed to initialize IPC service: %d", ret);
		return ret;
	} else {
		LOG_INF("M4: IPC service initialized successfully");
	}
	
	/* Register message callbacks */
	ret = hpi_ipc_register_callback(HPI_IPC_MSG_TYPE_TEST, ipc_test_msg_callback, NULL);
	if (ret < 0) {
		LOG_ERR("M4: Failed to register test callback: %d", ret);
		return ret;
	}
	
	ret = hpi_ipc_register_callback(HPI_IPC_MSG_TYPE_CMD, ipc_cmd_msg_callback, NULL);
	if (ret < 0) {
		LOG_ERR("M4: Failed to register command callback: %d", ret);
		return ret;
	}
	
	LOG_INF("M4: IPC callbacks registered successfully");

	return 0;
}
```

## src/ipc_module.h
```c
/*
 * Copyright (c) 2024 Protocentral
 *
 * SPDX-License-Identifier: MIT
 */

#ifndef IPC_MODULE_H
#define IPC_MODULE_H

#include <zephyr/kernel.h>
#include <zephyr/device.h>
#include <zephyr/ipc/ipc_service.h>
#include <zephyr/logging/log.h>

#ifdef __cplusplus
extern "C" {
#endif

/* IPC Message Types */
enum hpi_ipc_msg_type {
	HPI_IPC_MSG_TYPE_TEST = 0x01,
	HPI_IPC_MSG_TYPE_DATA = 0x02,      // Generic data (deprecated for new designs)
	HPI_IPC_MSG_TYPE_CMD  = 0x03,
	HPI_IPC_MSG_TYPE_STATUS = 0x04,
	HPI_IPC_MSG_TYPE_VERSION = 0x05,   // M4→M7: firmware version (sent at bind)
	
	/* PPG/SpO2 Algorithm Message Types */
	HPI_IPC_MSG_TYPE_PPG_RAW = 0x10,    // M7→M4: Raw PPG samples (Red+IR)
	HPI_IPC_MSG_TYPE_PPG_VITALS = 0x11, // M4→M7: Calculated SpO2+HR
	HPI_IPC_MSG_TYPE_PPG_CONFIG = 0x12, // M7→M4: Algorithm configuration
	
	/* ECG/QRS Algorithm Message Types */
	HPI_IPC_MSG_TYPE_ECG_RAW = 0x20,    // M7→M4: Raw ECG samples (3-lead)
	HPI_IPC_MSG_TYPE_ECG_VITALS = 0x21, // M4→M7: Calculated HR+HRV+QRS
	HPI_IPC_MSG_TYPE_ECG_CONFIG = 0x22, // M7→M4: Algorithm configuration
	HPI_IPC_MSG_TYPE_BEAT_NOTIFY = 0x23, // M4→M7: one QRS (struct hpi_ipc_beat_notify, 16 B)

	/* EEG/Mental State Algorithm Message Types */
	HPI_IPC_MSG_TYPE_EEG_RAW = 0x30,    // M7→M4: Raw EEG samples (ADC channels)
	HPI_IPC_MSG_TYPE_EEG_VITALS = 0x31, // M4→M7: Band powers+mental state
	HPI_IPC_MSG_TYPE_EEG_CONFIG = 0x32, // M7→M4: Algorithm configuration

	/* Arrhythmia/TFLite Classification Message Types */
	HPI_IPC_MSG_TYPE_ARRHYTHMIA_RESULT = 0x40,  // M4→M7: Per-beat classification
	HPI_IPC_MSG_TYPE_ARRHYTHMIA_STATS = 0x41,   // M4→M7: Periodic statistics
	HPI_IPC_MSG_TYPE_ARRHYTHMIA_ALERT = 0x42,   // M4→M7: Threshold alerts
	HPI_IPC_MSG_TYPE_ARRHYTHMIA_CONFIG = 0x43,  // M7→M4: Classification config
	HPI_IPC_MSG_TYPE_BEAT_WAVEFORM = 0x44,      // M4→M7: Beat waveform + classification
	HPI_IPC_MSG_TYPE_TFLITE_DEBUG = 0x45,       // M4→M7: TFLite debug info for diagnostics

	HPI_IPC_MSG_TYPE_MAX
};

/* IPC Message Structure */
struct hpi_ipc_msg {
	uint8_t type;
	uint8_t reserved;
	uint16_t length;
	uint8_t data[];
} __packed;

/* Maximum message size */
#define HPI_IPC_MAX_MSG_SIZE 512
#define HPI_IPC_MAX_DATA_SIZE (HPI_IPC_MAX_MSG_SIZE - sizeof(struct hpi_ipc_msg))

/* IPC Module APIs */

/**
 * @brief Initialize IPC module
 * 
 * @return 0 on success, negative error code on failure
 */
int hpi_ipc_init(void);

/**
 * @brief Send IPC message
 * 
 * @param msg_type Message type from enum hpi_ipc_msg_type
 * @param data Pointer to data to send
 * @param len Length of data
 * @return 0 on success, negative error code on failure
 */
int hpi_ipc_send(enum hpi_ipc_msg_type msg_type, const void *data, size_t len);

/**
 * @brief Check if IPC is ready for communication
 * 
 * @return true if ready, false otherwise
 */
bool hpi_ipc_is_ready(void);

/**
 * @brief Register callback for received messages
 * 
 * @param msg_type Message type to handle
 * @param callback Callback function to handle message
 * @param user_data User data passed to callback
 * @return 0 on success, negative error code on failure
 */
typedef void (*hpi_ipc_msg_callback_t)(enum hpi_ipc_msg_type msg_type,
					const void *data, size_t len,
					void *user_data);

int hpi_ipc_register_callback(enum hpi_ipc_msg_type msg_type,
			      hpi_ipc_msg_callback_t callback,
			      void *user_data);

/**
 * @brief Get IPC statistics
 */
struct hpi_ipc_stats {
	uint32_t messages_sent;
	uint32_t messages_received;
	uint32_t send_errors;
	uint32_t receive_errors;
};

void hpi_ipc_get_stats(struct hpi_ipc_stats *stats);

/**
 * @brief Initialize M4-specific IPC functionality with default callbacks
 * 
 * This function initializes the IPC service, registers default message
 * handlers for common message types, and starts the IPC thread for the M4 core.
 * 
 * @return 0 on success, negative error code on failure
 */
int hpi_ipc_m4_init(void);

#ifdef __cplusplus
}
#endif


/* M4 firmware version report (M4 -> M7), sent once when the endpoint binds;
 * surfaces as m4fw in group-64 device_info / fw_versions. Fixed 32 B and
 * NUL-terminated so a shorter string never leaks stale bytes across the IPC
 * boundary. */
#define HPI_IPC_VERSION_STR_MAX 32

struct hpi_ipc_version {
    char version[HPI_IPC_VERSION_STR_MAX];
} __packed;

#endif /* IPC_MODULE_H */
```
