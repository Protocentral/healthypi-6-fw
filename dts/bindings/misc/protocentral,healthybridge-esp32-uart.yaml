## dts/bindings/misc/protocentral,healthybridge-esp32-uart.yaml
```yaml
# Copyright (c) 2025-2026 Protocentral
# SPDX-License-Identifier: MIT

description: |
  HealthyBridge-ESP32 host link over UART -- the framed binary transport to the
  ESP32-C6 co-processor (WiFi/BLE re-streaming).

  Declared as a child of the UART node that carries the link. The parent UART
  supplies the baud rate, the RTS/CTS pinmux and `hw-flow-control`; this node
  only marks which UART is the HealthyBridge link and carries the co-processor's
  control GPIOs.

  Carries the same frame codec as the SPI transport
  (protocentral,healthybridge-esp32-spi) -- sync 0xAA55, 8-byte header,
  CRC-16/CCITT reflected, identical payload structs. Exactly ONE of the two
  nodes may be enabled at a time; they are alternative physical transports for
  an identical wire contract. See docs/connectivity/SPI_TO_UART_MIGRATION.md.

  Example devicetree node:

    &uart4 {
        current-speed = <921600>;
        hw-flow-control;

        healthybridge_esp32_uart: healthybridge-esp32-uart {
            compatible = "protocentral,healthybridge-esp32-uart";
            reset-gpios = <&gpioa 11 GPIO_ACTIVE_LOW>;
            status = "okay";
        };
    };

compatible: "protocentral,healthybridge-esp32-uart"

include: base.yaml

properties:
  reset-gpios:
    type: phandle-array
    description: |
      ESP32-C6 reset line (active low). Driven at init to bring the
      co-processor up in a known state; the driver then waits
      CONFIG_HEALTHYBRIDGE_ESP32_BOOT_DELAY_MS before transmitting.

  ready-gpios:
    type: phandle-array
    description: |
      Optional ESP32-C6 "ready" indication, input to the M7. Not required for
      the UART transport -- hardware RTS/CTS provides flow control -- but kept
      available where the board routes it.
```

## dts/bindings/misc/protocentral,healthybridge-esp32.yaml
```yaml
# Copyright (c) 2025 Protocentral
# SPDX-License-Identifier: MIT

description: |
  HealthyBridge-ESP32 WiFi/BLE driver for ESP32-C6 co-processor.
  
  This driver provides WiFi connectivity and BLE services via an ESP32-C6
  running custom Zephyr firmware. Communication uses UART for JSON commands
  and SPI for high-speed binary data streaming.
  
  The device must be declared as a child of an SPI bus node.
  
  Example devicetree node:
  
  &spi2 {
      healthybridge_esp32: healthybridge-esp32@0 {
          compatible = "protocentral,healthybridge-esp32";
          reg = <0>;
          spi-max-frequency = <20000000>;
          status = "okay";
          
          uart = <&uart4>;
          reset-gpios = <&gpioa 11 GPIO_ACTIVE_LOW>;
          ready-gpios = <&gpiob 1 GPIO_ACTIVE_HIGH>;
          data-ready-gpios = <&gpiob 13 GPIO_ACTIVE_HIGH>;
      };
  };

compatible: "protocentral,healthybridge-esp32"

include: spi-device.yaml

properties:
  uart:
    type: phandle
    required: true
    description: |
      UART device used for JSON command protocol.
      Must be configured with hw-flow-control enabled.

  reset-gpios:
    type: phandle-array
    required: true
    description: |
      GPIO connected to ESP32-C6 EN (reset) pin.

  ready-gpios:
    type: phandle-array
    description: |
      GPIO connected to ESP32-C6 ready signal.
      Indicates when ESP32 is ready for commands.

  data-ready-gpios:
    type: phandle-array
    description: |
      GPIO connected to ESP32-C6 data-ready signal.
      Indicates when SPI buffer is ready for data.
```

## dts/bindings/misc/protocentral,healthylink-slot.yaml
```yaml
# Copyright (c) 2026 ProtoCentral
# SPDX-License-Identifier: MIT

description: |
  HealthyPi 6 HealthyLink expansion slot (per-slot physical connector).

  One node per physical module slot (A, B, ...). This binding models only the
  static, slot-level resources that belong to the connector itself:
    - the load-switch enable that gates power to the slot,
    - the load-switch fault indicator,
    - a reference to the slot's ID EEPROM.

  Module presence and identity are detected SOLELY via the slot's ID EEPROM -
  there is no dedicated module-present/detect GPIO. Firmware powers the slot,
  then probes the EEPROM: an I2C ACK means a module is seated, and the EEPROM
  contents identify the module type.

  The module's *functional* device (e.g. the ADS1299 EEG AFE, an NPU, an
  FDCAN transceiver) is NOT described here. It is a normal bus child (SPI/I2C)
  with its own chip binding and `zephyr,deferred-init`, brought up at runtime
  only after the slot's EEPROM identifies which module is plugged in. This
  keeps a single firmware image able to auto-detect any module, while the slot
  node provides the per-slot power/fault that the connector owns.

compatible: "protocentral,healthylink-slot"

include: base.yaml

properties:
  power-gpios:
    type: phandle-array
    required: true
    description: |
      Load-switch enable that gates power to this slot. Single entry, driven
      active to power the slot (typically GPIO_ACTIVE_HIGH).

  fault-gpios:
    type: phandle-array
    description: |
      Load-switch fault indicator for this slot. Single entry, asserted by the
      switch on over-current / thermal fault (typically GPIO_ACTIVE_LOW with a
      pull-up).

  eeprom:
    type: phandle
    description: |
      Phandle to the I2C ID EEPROM for this slot. This is the slot's detection
      mechanism: an I2C ACK from the EEPROM means a module is present, and its
      contents identify the module type. No separate detect GPIO is used.

  slot-label:
    type: string
    description: Human-readable slot designator, e.g. "A" or "B".
```

## dts/bindings/sensor/protocentral,bmi323-i2c.yaml
```yaml
# Copyright (c) 2026 Protocentral Electronics
# SPDX-License-Identifier: MIT

description: |
  Bosch BMI323 6-axis IMU on I2C. Forked locally because the upstream
  Zephyr bosch,bmi323 binding/driver is SPI-only (2026-Q2). The wire
  protocol matches the upstream driver's SPI semantics minus the dummy
  read byte; the upstream bmi323.c logic is reused unchanged.

  The BMI323 I2C address depends on the SDO pin strap: SDO tied low =
  0x68 (7-bit), SDO tied high = 0x69.

  Example:

    &i2c2 {
        imu@68 {
            compatible = "protocentral,bmi323-i2c";
            reg = <0x68>;
            int-gpios = <&gpiob 0 GPIO_ACTIVE_HIGH>;
        };
    };

compatible: "protocentral,bmi323-i2c"

include: ["i2c-device.yaml", "sensor-device.yaml"]

properties:
  int-gpios:
    type: phandle-array
    description: |
      INT1 line from the IMU. The upstream BMI323 driver routes every
      interrupt it uses (DRDY, any-motion) to INT1 only.
```

## dts/bindings/sensor/ti,ads1299.yaml
```yaml
# Copyright (c) 2025 ProtoCentral Electronics
# SPDX-License-Identifier: MIT

description: |
  Texas Instruments ADS1299 - 8-Channel 24-Bit Low-Noise ADC for EEG/Biopotential

  The ADS1299 is a low-noise, 8-channel, 24-bit analog-to-digital converter
  designed specifically for EEG and biopotential measurements.

  This is a separate driver from ADS129xx (ECG) due to EEG-specific features:
  - 8 fixed channels
  - Different gain mapping (includes 24x for EEG)
  - BIAS drive circuit for patient reference
  - SRB1/SRB2 reference routing for EEG montages
  - No respiration demodulation

  Key Specifications:
  - 8 differential input channels
  - 24-bit resolution (< 1 µVpp noise @ gain=24)
  - Sample rates: 250, 500, 1000, 2000, 4000, 8000, 16000 SPS
  - Programmable gain: 1, 2, 4, 6, 8, 12, 24
  - Internal 2.4V reference
  - SPI interface (Mode 1: CPOL=0, CPHA=1)
  - SPI clock: 4 MHz max

  Example:
    &spi4 {
        ads1299: ads1299@0 {
            compatible = "ti,ads1299";
            reg = <0>;
            spi-max-frequency = <4000000>;
            drdy-gpios = <&gpioi 2 GPIO_ACTIVE_LOW>;
            reset-gpios = <&gpioi 3 GPIO_ACTIVE_LOW>;
            pwdn-gpios = <&gpioi 6 GPIO_ACTIVE_LOW>;
            start-gpios = <&gpioa 9 GPIO_ACTIVE_HIGH>;
            gain = <24>;
            sample-rate = <250>;
            bias-enabled;
            srb1-enabled;
        };
    };

compatible: "ti,ads1299"

include: [sensor-device.yaml, spi-device.yaml]

properties:
  drdy-gpios:
    type: phandle-array
    required: true
    description: |
      Data Ready GPIO. Active low, pulses when new sample data is available.
      Connect to an interrupt-capable GPIO for efficient data acquisition.

  reset-gpios:
    type: phandle-array
    required: true
    description: |
      Reset GPIO. Active low. Asserting low resets all internal registers
      to their default values. Hold low for at least 2 tCLK cycles.

  pwdn-gpios:
    type: phandle-array
    required: true
    description: |
      Power Down GPIO. Active low. Asserting low puts the device into
      a low-power standby mode. All analog circuitry is powered down.

  start-gpios:
    type: phandle-array
    required: false
    description: |
      Start/Stop GPIO. Active high. When high, enables continuous
      data conversion. When low, conversions stop after current sample.

      Optional: the ADS1299 can equally be started and stopped with the START
      and STOP SPI opcodes, which the driver already issues alongside this pin.
      Omit the property on a board that does not route START to the MCU (v5 does
      not -- PI2 became MOD_RESET_A) and the driver uses the commands alone.

  gain:
    type: int
    default: 24
    description: |
      PGA gain for all channels. For EEG applications, gain of 24 is typical.
      Valid values: 1, 2, 4, 6, 8, 12, 24
      - Gain 24: ±187.5mV input range, optimal for EEG
      - Gain 12: ±375mV input range
      - Gain 1: ±4.5V input range
    enum:
      - 1
      - 2
      - 4
      - 6
      - 8
      - 12
      - 24

  sample-rate:
    type: int
    default: 250
    description: |
      Output data rate in samples per second.
      Higher rates have higher noise floor.
      250 SPS is recommended for most EEG applications.
    enum:
      - 250
      - 500
      - 1000
      - 2000
      - 4000
      - 8000
      - 16000

  bias-enabled:
    type: boolean
    description: |
      Enable BIAS (patient reference) drive circuit.
      When enabled, the BIAS electrode provides a reference potential
      to reduce common-mode interference. Recommended for EEG.

  srb1-enabled:
    type: boolean
    description: |
      Enable SRB1 as reference for all negative inputs.
      Useful for common reference montage where all channels share
      a single reference electrode. Common in clinical EEG setups.
```

## dts/bindings/sensor/ti,ads129xx.yaml
```yaml
# ProtoCentral Electronics (info@protocentral.com)
# SPDX-License-Identifier: Apache-2.0

description: ADS129XX SPI Device

compatible: "ti,ads129xx"

include: [sensor-device.yaml, spi-device.yaml]

properties:
  pwdn-gpios:
    type: phandle-array
    description: |
      Powerdown pin required
  
  reset-gpios:
    type: phandle-array
    description: |
      Reset pin required
  
  drdy-gpios:
    type: phandle-array
    description: |
      Data ready pin required
  
  start-gpios:
    type: phandle-array
    description: |
      Start pin required
  
  gain:
    type: int
    description: |
      PGA gain for all channels. Maps to GAINn[2:0] bits in CHnSET register.
      Valid values: 1, 2, 3, 4, 6, 8, 12
    default: 3
    enum:
      - 1
      - 2
      - 3
      - 4
      - 6
      - 8
      - 12
  
```

## dts/bindings/sensor/ti,afe4400.yaml
```yaml
# ProtoCentral Electronics (info@protocentral.com)
# SPDX-License-Identifier: Apache-2.0

description: AFE4400 SPI Device

compatible: "ti,afe4400"

include: [sensor-device.yaml, spi-device.yaml]

properties:
  pwdn-gpios:
    type: phandle-array
    required: true
    description: |
      Powerdown pin required
  drdy-gpios:
    type: phandle-array
    required: true
    description: |
      Data-ready interrupt GPIO used to signal when a new conversion/result
      is available from the device.
  reset-gpios:
    type: phandle-array
    required: true
    description: |
      Reset pin used to reset the AFE4400 device. Active low. 
```
