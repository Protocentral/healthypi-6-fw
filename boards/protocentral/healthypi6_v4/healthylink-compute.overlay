/*
 * HealthyLink Compute Module Overlay (v4)
 * Copyright (c) 2025-2026 ProtoCentral
 * SPDX-License-Identifier: MIT
 *
 * External AI/ML compute module for inference offload.
 * Module ID: 0x0005
 *
 * Wiring (HealthyPi6 v4 main board, STM32H757 master):
 *   SPI4: PE2 (SCK), PE5 (MISO), PE6 (MOSI), PE4 (NSS/CS, software-driven)
 *   GPIO: PI12 (IRQ from module, active-low, aux-gpios[0])
 *         PI3  (module RESET) - shared with EEG module RESET line
 *         PI6  (module PWDN)  - shared with EEG module PWDN line
 *   Power: PI1 (EN_MOD_A) / PH11 (MOD_A_FLT) - owned by healthylink_slot_a
 *
 * HealthyLink Compute (STM32N657 slave) speaks SPI5 slave at the other end of
 * the same connector pins (its local pin names PG12/PD4/PF11/PA3 are N6-side
 * and do NOT appear on the H7). Communication is SPI mode 0 @ 20 MHz with the
 * 1-byte command protocol in `spi_slave_handler.h` (AI_CMD_NOP / STATUS /
 * GET_INFO / ...).
 *
 * Usage:
 *   west build -b healthypi6_v4/stm32h757xx/m7 app_m7 \
 *       -DEXTRA_DTC_OVERLAY_FILE="boards/protocentral/healthypi6_v4/healthylink-compute.overlay"
 */

/* SPI4 is enabled by the v4 base DTS with the EEG ADS1299 child node using
 * zephyr,deferred-init - both module drivers coexist in one binary and only
 * the one matching the EEPROM module ID is brought up. We only need to
 * attach the HealthyLink Compute child node here. */
&spi4 {
	/* HealthyLink Compute SPI Device (deferred-init: only brought up when the
	 * slot EEPROM reports module ID 0x0005). */
	healthylink_compute: compute@0 {
		compatible = "protocentral,healthylink-compute";
		reg = <0>;
		spi-max-frequency = <20000000>;  /* 20 MHz, Mode 0 */

		/* IRQ from module: aux-gpios[0] on v4 (PI12). Module asserts
		 * low to signal inference complete / heartbeat. */
		irq-gpios = <&gpioi 12 (GPIO_ACTIVE_LOW | GPIO_PULL_UP)>;

		/* RESET / PWDN are shared with the EEG module's control GPIOs
		 * (PI3 / PI6) - only one module is in the slot at a time. */
		reset-gpios = <&gpioi 3 GPIO_ACTIVE_HIGH>;
		pwdn-gpios  = <&gpioi 6 GPIO_ACTIVE_HIGH>;

		status = "okay";
		zephyr,deferred-init;
	};
};
