## boards/protocentral/healthypi6_v2/Kconfig.healthypi6_v2
```kconfig
# STM32H747I DISCOVERY board configuration

# Copyright (c) 2019 Linaro Limited
# SPDX-License-Identifier: Apache-2.0

config BOARD_HEALTHYPI6_V2
	select SOC_STM32H757XX_M7 if BOARD_HEALTHYPI6_V2_STM32H757XX_M7
	select SOC_STM32H757XX_M4 if BOARD_HEALTHYPI6_V2_STM32H757XX_M4
```

## boards/protocentral/healthypi6_v2/board.yml
```yaml
board:
  name: healthypi6_v2
  full_name: Protocentral HealthyPi 6 v2
  vendor: protocentral
  socs:
    - name: stm32h757xx
```

## boards/protocentral/healthypi6_v3/board.yml
```yaml
board:
  name: healthypi6_v3
  full_name: Protocentral HealthyPi 6 v3
  vendor: protocentral
  socs:
    - name: stm32h757xx
```

## boards/protocentral/healthypi6_v3/healthypi6_v3_stm32h757xx_m4_defconfig
```kconfig
# SPDX-License-Identifier: Apache-2.0
# Copyright (c) 2019 STMicroelectronics

# Enable GPIO
CONFIG_GPIO=y

# Enable MPU
CONFIG_ARM_MPU=n

# Enable HW stack protection
CONFIG_HW_STACK_PROTECTION=y
```

## boards/protocentral/healthypi6_v4/Kconfig.healthypi6_v4
```kconfig
# HealthyPi 6 v4 board configuration

# Copyright (c) 2019 Linaro Limited
# Copyright (c) 2026 ProtoCentral
# SPDX-License-Identifier: Apache-2.0

config BOARD_HEALTHYPI6_V4
	select SOC_STM32H757XX_M7 if BOARD_HEALTHYPI6_V4_STM32H757XX_M7
	select SOC_STM32H757XX_M4 if BOARD_HEALTHYPI6_V4_STM32H757XX_M4
```

## boards/protocentral/healthypi6_v4/board.yml
```yaml
board:
  name: healthypi6_v4
  full_name: Protocentral HealthyPi 6 v4
  vendor: protocentral
  socs:
    - name: stm32h757xx
```

## boards/protocentral/healthypi6_v5/board.yml
```yaml
board:
  name: healthypi6_v5
  full_name: Protocentral HealthyPi 6 v5
  vendor: protocentral
  socs:
    - name: stm32h757xx
```

## drivers/display/Kconfig
```kconfig
menuconfig DISPLAY
	bool "Display Drivers"
	help
	  Enable display drivers

if DISPLAY

config DISPLAY_INIT_PRIORITY
	int "Display devices init priority"
	default 85
	help
	  Display devices initialization priority.

module = DISPLAY
module-str = display

source "subsys/logging/Kconfig.template.log_config"

rsource "Kconfig.ili9881c_dsi"
rsource "Kconfig.gc9503v_dsi"

endif
```

## drivers/display/Kconfig.gc9503v_dsi
```kconfig
# SPDX-License-Identifier: Apache-2.0

config GC9503V_DSI
	bool "GC9503V_DSI display driver"
	default y
	depends on DT_HAS_GALAXYCORE_GC9503V_DSI_ENABLED
	select MIPI_DSI
	help
	  Enable driver for GC9503V MIPI-DSI display controller.

if GC9503V_DSI

config DISPLAY_GC9503V_DSI_INIT_PRIORITY
	int "Initialization priority"
	default 90
	help
	  GC9503V_DSI display driver initialization priority.

endif
```

## drivers/misc/Kconfig
```kconfig
# Copyright (c) 2025 ProtoCentral Electronics
# SPDX-License-Identifier: Apache-2.0

menu "Miscellaneous Drivers"

rsource "healthybridge_esp32/Kconfig.healthybridge_esp32"
rsource "healthylink/Kconfig"
rsource "mp2696/Kconfig"

endmenu
```

## drivers/misc/healthybridge_esp32/Kconfig.healthybridge_esp32
```kconfig
# HealthyBridge-ESP32 co-processor host link

# Copyright (c) 2025-2026 Protocentral
# SPDX-License-Identifier: Apache-2.0

# The link is enabled by devicetree (the healthybridge_esp32_uart node), not by
# Kconfig.

config HEALTHYBRIDGE_ESP32_UART
	bool
	default y
	depends on DT_HAS_PROTOCENTRAL_HEALTHYBRIDGE_ESP32_UART_ENABLED
	select UART_ASYNC_API
	help
	  Selected automatically when the healthybridge_esp32_uart devicetree
	  node is enabled. Not user-settable.

	  UART_ASYNC_API is a hard requirement, not a preference: the transmit
	  path is DMA, and at 2 Mbaud an interrupt-per-byte transmitter would
	  cost roughly 200k interrupts per second. The driver carries a
	  BUILD_ASSERT so a build that somehow loses the symbol fails loudly
	  instead of quietly running the stream off the CPU.

config HEALTHYBRIDGE_ESP32_INIT_PRIORITY
	int "HealthyBridge driver initialization priority"
	default 90
	help
	  Initialization priority for the HealthyBridge-ESP32 driver.
	  Must be higher than the UART controller driver.

config HEALTHYBRIDGE_ESP32_HOLD_RESET_AT_BOOT
	bool "Hold the ESP32-C6 in reset until connectivity is enabled"
	default y
	help
	  Leave the co-processor's EN/reset line ASSERTED when the driver
	  initialises, so the C6 never boots unless something asks for it via
	  healthybridge_link_power() (services/connectivity ->
	  hpi_connectivity_enable()).

	  This is a power decision, not a convenience. The C6 brings both radios
	  up on its own at boot -- an unprovisioned unit opens a sticky SoftAP and
	  beacons forever -- and it does so ~220 ms into M7 bring-up, concurrent
	  with SDRAM, the backlight, sensor init and USB enumeration. On a unit
	  powered only from USB that peak is enough to brown out the 3V3 rail and
	  reset the board. The BQ24074's input ceiling is strapped by EN1/EN2 and
	  the part has no register interface, so drawing less is the only lever
	  firmware has.

	  Say n to restore the pre-2026-08 behaviour (pulse reset at init, let the
	  C6 boot immediately). Useful on the bench when the co-processor is the
	  thing under test -- note that with y, the C6 is held in reset and cannot
	  be flashed over its own USB port while the M7 application is running.

config HEALTHYBRIDGE_ESP32_BOOT_DELAY_MS
	int "ESP32-C6 boot delay in milliseconds"
	default 800
	help
	  Time to wait after releasing reset before the ESP32-C6 is expected to
	  answer a control command.

	  Read by healthybridge_link_power(dev, true). Until 2026-08 this symbol
	  was declared but never referenced by any code -- the real wait was a
	  hardcoded 200 ms in hb_uart_init(), a 15x shorter window than the
	  default here claimed -- so the default came down from 3000 to a value
	  that reflects what the part actually needs.

config HEALTHYBRIDGE_ESP32_DEBUG
	bool "Enable HealthyBridge debug logging"
	help
	  Enable verbose debug logging for the HealthyBridge-ESP32 driver.
```

## drivers/misc/healthylink/Kconfig
```kconfig
# HealthyLink Expansion Port Driver Configuration
# Copyright (c) 2025 ProtoCentral
# SPDX-License-Identifier: Apache-2.0

menuconfig HEALTHYLINK
	bool "HealthyLink Expansion Port Support"
	default y
	depends on I2C
	help
	  Enable support for HealthyLink expansion modules on the
	  HealthyPi 6 expansion connector. HealthyLink provides a
	  modular interface for EEG, EMG, trigger I/O, CAN, and
	  HealthyLink Compute expansion boards.

if HEALTHYLINK

config HEALTHYLINK_INIT_PRIORITY
	int "HealthyLink driver initialization priority"
	default 90
	help
	  Initialization priority for the HealthyLink controller driver.
	  Should be after I2C (default 50) but before application code.

config HEALTHYLINK_AUTO_DETECT
	bool "Auto-detect connected modules at boot"
	default n
	help
	  Automatically detect connected HealthyLink modules by reading
	  the I2C EEPROM at startup. If disabled (recommended), call
	  healthylink_detect() manually from application code after
	  hardware initialization is complete.

	  NOTE: When using auto-provisioning with module overlays, this
	  should be disabled and detection triggered from hw_module.c
	  after the module hardware (e.g., ADS1299) is initialized.

config HEALTHYLINK_AUTO_PROVISION
	bool "Auto-provision blank EEPROMs"
	default y
	help
	  When a blank EEPROM is detected (all 0xFF or all 0x00 in magic),
	  automatically write the module identity based on:
	  1. Device tree overlay (if module-id is specified)
	  2. Hardware probing (detect connected chip IDs)

	  This eliminates the need for external EEPROM programmers during
	  module manufacturing or development.

config HEALTHYLINK_REPROVISION_NAME
	bool "Rewrite an already-provisioned EEPROM's name field on boot"
	default n
	help
	  One-shot maintenance helper: on a non-blank, valid EEPROM whose stored
	  module name does not match the canonical name for its module ID
	  (healthylink_module_name()), rewrite ONLY the name field (preserving
	  module ID, capabilities, serial, manufacturer, etc.) and recompute the
	  CRC. Used to migrate fielded modules to a renamed module string (e.g.
	  "AI-ACCELERATOR" -> "HealthyLink Compute"). Enable, build, flash, boot
	  once to rewrite, then disable again for normal builds.

	  The provisioned data includes:
	  - Module ID, name, manufacturer
	  - Hardware revision, capabilities
	  - Auto-generated serial number (based on MCU unique ID)

	  NOTE: This is triggered when healthylink_detect() is called,
	  either automatically (if AUTO_DETECT=y) or manually from
	  application code (recommended).

config HEALTHYLINK_LOG_LEVEL
	int "HealthyLink log level"
	default 3
	range 0 4
	help
	  Log level for HealthyLink drivers:
	  0 = Off, 1 = Error, 2 = Warning, 3 = Info, 4 = Debug

config HEALTHYLINK_EEG_8CH
	bool "EEG-8CH Module Support"
	depends on SPI
	help
	  Enable driver for 8-channel EEG expansion module using
	  Texas Instruments ADS1299.

	  Uses: SPI4, GPIO (DRDY, RESET, PWDN, START)

if HEALTHYLINK_EEG_8CH

config HEALTHYLINK_EEG_THREAD_STACK_SIZE
	int "EEG sampling thread stack size"
	default 1024
	help
	  Stack size for the EEG sampling thread.

config HEALTHYLINK_EEG_THREAD_PRIORITY
	int "EEG sampling thread priority"
	default 5
	help
	  Priority for the EEG sampling thread.
	  Lower number = higher priority.

endif # HEALTHYLINK_EEG_8CH

config HEALTHYLINK_CAN_INTERFACE
	bool "CAN Interface Module Support"
	depends on CAN
	help
	  Enable driver for FDCAN lab equipment interface module.

	  Uses: FDCAN1

config HEALTHYLINK_TRIGGER_IO
	bool "Trigger I/O Module Support"
	depends on GPIO
	help
	  Enable driver for lab trigger input/output module with
	  precise timestamping.

	  Uses: GPIO (PI2, PI3, PI6, PA9, PA10)

config HEALTHYLINK_COMPUTE
	bool "HealthyLink Compute Module Support"
	depends on SPI
	help
	  Enable driver for external AI/ML compute accelerator module.

	  Uses: SPI6, GPIO (CS, IRQ, RESET)

config HEALTHYLINK_LLEXT_FALLBACK
	bool "Load unknown modules via LLEXT"
	depends on LLEXT
	depends on FILE_SYSTEM
	help
	  When an unknown module ID is detected, attempt to load
	  a driver from the SD card using Zephyr's Linkable Loadable
	  Extensions (LLEXT) subsystem.

	  Driver files should be placed at:
	  /SD:/healthylink/mod_XXXX.llext

	  where XXXX is the 4-digit hex module ID.

if HEALTHYLINK_LLEXT_FALLBACK

config HEALTHYLINK_LLEXT_PATH
	string "LLEXT module path prefix"
	default "/SD:/healthylink/"
	help
	  Path prefix for loading LLEXT module drivers.
	  The module ID (as 4-digit hex) and ".llext" suffix
	  will be appended.

endif # HEALTHYLINK_LLEXT_FALLBACK

endif # HEALTHYLINK
```

## drivers/misc/mp2696/Kconfig
```kconfig
# Copyright (c) 2026 Protocentral Electronics
# SPDX-License-Identifier: Apache-2.0

config MP2696
	bool "MP2696B battery charger driver"
	default y
	depends on DT_HAS_MPS_MP2696_ENABLED
	select I2C
	help
	  Enable driver for the Monolithic Power MP2696B single-cell Li-ion
	  switching charger with power-path management and boost output.

if MP2696

config MP2696_INIT_PRIORITY
	int "MP2696 init priority"
	default 85
	help
	  Post-kernel init priority. Must be higher than the I2C controller
	  driver priority so the bus is ready when this driver probes.

module = MP2696
module-str = mp2696
source "subsys/logging/Kconfig.template.log_config"

endif # MP2696
```

## drivers/sensor/ads1299/Kconfig
```kconfig
# Texas Instruments ADS1299 8-Channel EEG AFE Driver
# Copyright (c) 2025 ProtoCentral Electronics
# SPDX-License-Identifier: Apache-2.0

config SENSOR_ADS1299
	bool "ADS1299 8-Channel EEG Analog Front-End"
	default y
	depends on SPI
	depends on GPIO
	help
	  Enable driver for the Texas Instruments ADS1299 8-channel, 24-bit
	  analog front-end designed for EEG and biopotential measurements.

	  The ADS1299 features:
	  - 8 differential input channels
	  - 24-bit resolution with low noise (< 1 µVpp at gain=24)
	  - Programmable gain: 1, 2, 4, 6, 8, 12, 24
	  - Sample rates: 250 to 16000 SPS
	  - BIAS drive circuit for patient reference
	  - SRB1/SRB2 reference routing for EEG montages

	  This driver is separate from ADS129xx (ECG) due to EEG-specific
	  features and different gain mapping.

if SENSOR_ADS1299

config SENSOR_ADS1299_INIT_PRIORITY
	int "ADS1299 initialization priority"
	default 80
	help
	  ADS1299 device driver initialization priority.
	  Should be after SPI (default 50) but before application code.

config SENSOR_ADS1299_TRIGGER
	bool "Enable ADS1299 DRDY trigger support"
	default y
	help
	  Enable DRDY (Data Ready) interrupt trigger support.
	  When enabled, the driver uses GPIO interrupts to signal
	  when new sample data is available.

endif # SENSOR_ADS1299
```

## drivers/sensor/ads129xx/Kconfig
```kconfig
# Configuration options for TI ADS129x family ADCs
# Copyright (c) 2025 ProtoCentral Electronics
# SPDX-License-Identifier: Apache-2.0

config SENSOR_ADS129XX
	bool "ADS129XX/ADS1299 Driver"
	default y
	depends on SPI
	help
	  Enable the driver for the TI ADS129XX family of analog front-ends.
	  This includes:
	  - ADS1294R: 4-channel 24-bit ECG AFE (used on HealthyPi 6 main board)
	  - ADS1296R: 6-channel 24-bit ECG AFE
	  - ADS1298R: 8-channel 24-bit ECG AFE
	  - ADS1299: 8-channel 24-bit EEG AFE (used on HealthyLink EEG-8CH module)

	  The driver automatically detects the number of channels from the
	  device ID register and supports both ECG (with respiration on ADS129xR)
	  and EEG (ADS1299) configurations.

if SENSOR_ADS129XX

config SENSOR_ADS129XX_INIT_PRIORITY
	int "Init priority"
	default 80
	help
	  ADS129XX device driver initialization priority.
	  Should be after SPI (default 50) but before application code.

config SENSOR_ADS129XX_TRIGGER
	bool "Enable trigger support"
	default y
	help
	  Enable DRDY (Data Ready) interrupt trigger support.
	  When enabled, the driver uses GPIO interrupts to signal
	  when new sample data is available.

config SENSOR_ADS129XX_RESP_PHASE
	int "Respiration demodulation phase code (RESP_PH[2:0])"
	range 0 6
	default 4
	help
	  Demodulation phase, in 22.5 degree steps starting at 22.5 degrees
	  (0 = 22.5, 4 = 112.5, 6 = 157.5). The default is TI's value for a
	  32 kHz modulation clock (SBAA181). The demodulated output scales with
	  the cosine of the phase error, so tune this on the bench: sweep 0..6
	  and keep the code that gives the largest respiration amplitude.

config SENSOR_ADS129XX_RESP_GAIN
	int "Respiration channel (CH1) PGA gain"
	range 1 12
	default 4
	help
	  PGA gain for the respiration channel. Valid values: 1, 2, 3, 4, 6,
	  8, 12. Lower it if raw CH1 sits near full scale (carrier clipping).
	  The app's respiration µV conversion follows this value.

endif # SENSOR_ADS129XX
```
