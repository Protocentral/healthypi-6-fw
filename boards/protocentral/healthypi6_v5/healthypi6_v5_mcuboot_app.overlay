/*
 * app_m7-image overlay for healthypi6_v5 (M7) — SIGNED flavor only.
 * Passed by scripts/build.sh signed via -Dapp_m7_EXTRA_DTC_OVERLAY_FILE
 * (appended after the display + HealthyLink overlays).
 * The signed app links into slot0_partition (flash0 @ 0x08020000, 896 KB);
 * CONFIG_BOOTLOADER_MCUBOOT selects USE_DT_CODE_PARTITION, which makes the
 * linker honour this chosen node.
 */

#include "healthypi6_v5_mcuboot_partitions.dtsi"
/* Same boot-mode retention area the bootloader reads — see the dtsi header for
 * why both images must include it and why it lives in backup SRAM. */
#include "healthypi6_v5_bootmode.dtsi"

/ {
	chosen {
		zephyr,code-partition = &slot0_partition;
	};
};
