/*
 * HealthyLink Compute module (STM32N657, module ID 0x0005)
 * Copyright (c) 2025-2026 ProtoCentral
 * SPDX-License-Identifier: MIT
 *
 * Added to the default build by scripts/build.sh m7. The module works in either
 * slot and is driven by app_m7/src/healthylink/mod_npu.c, which does not read
 * this node's pins: SPI4 with CS_A (PE4) and IRQ PI12 in either slot. Slot
 * power and fault come from healthylink_slot_a / _b.
 */

&spi4 {
	healthylink_compute: compute@0 {
		compatible = "protocentral,healthylink-compute";
		reg = <0>;
		spi-max-frequency = <20000000>;
		irq-gpios = <&gpioi 12 (GPIO_ACTIVE_LOW | GPIO_PULL_UP)>;
		reset-gpios = <&gpioi 2 GPIO_ACTIVE_HIGH>;   /* MOD_RESET_A */
		pwdn-gpios = <&gpioi 6 GPIO_ACTIVE_HIGH>;    /* shared with EEG */
		status = "okay";
		zephyr,deferred-init;
	};
};
